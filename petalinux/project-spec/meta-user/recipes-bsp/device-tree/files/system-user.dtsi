/include/ "system-conf.dtsi"
/ {
	/*
	 * Keeps pl_clk0 running. Linux switches off every clock that no
	 * device claims, and nothing else in this tree uses the PL clock
	 * because the PL has no device-tree nodes. Without this the PL has
	 * no clock after boot and the first register access hangs.
	 * 71 is PL0_REF in dt-bindings/clock/xlnx-zynqmp-clk.h.
	 */
	scam_pl_clk0: scam-pl-clk0 {
		compatible = "xlnx,fclk";
		clocks = <&zynqmp_clk 71>;
	};

	/*
	 * Buffer that yeet-data-tdc hands to the AXI DMA and maps through
	 * /dev/mem. It must be kept out of the kernel's memory, or the DMA
	 * overwrites pages Linux is using. Keep in step with DMA_RAM_BASE and
	 * DMA_RAM_SIZE in sw/common/reg_io.h.
	 */
	reserved-memory {
		#address-cells = <2>;
		#size-cells = <2>;
		ranges;

		scam_dma_buffer: scam-dma-buffer@70000000 {
			reg = <0x0 0x70000000 0x0 0x00100000>;
			no-map;
		};
	};
};
